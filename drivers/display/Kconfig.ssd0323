## drivers/display/Kconfig.ssd0323
```kconfig
# Kconfig - SSD0323 display controller configuration options

#
# Copyright (c) 2018 Zilogic Systems
#
# SPDX-License-Identifier: Apache-2.0
#

menuconfig SSD0323
	bool "SSD0323 display driver"
	depends on SPI
	help
	  Enable driver for SSD0323 display driver.
```

## dts/bindings/display/solomon,ssd0323fb-spi.yaml
```yaml
#
# Copyright (c) 2018, Phytec Messtechnik GmbH
#
# SPDX-License-Identifier: Apache-2.0
#
---
title: SSD0323 120x80 Display Controller
version: 0.1

description: >
    This is a representation of the SSD0323 120x80 Display Controller

inherits:
    !include spi-device.yaml

properties:
    compatible:
      constraint: "solomon,ssd0323fb-spi"

    height:
      type: int
      category: required
      description: Height in pixel of the panel driven by the controller
      generation: define

    width:
      type: int
      category: required
      description: Width in pixel of the panel driven by the controller
      generation: define


    dc-gpios:
      type: compound
      category: required
      generation: define, use-prop-name

    cs-gpios:
      type: compound
      category: required
      generation: define, use-prop-name

...
```
